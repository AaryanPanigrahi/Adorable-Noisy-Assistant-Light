// Neo Pixel Ring
#include <Adafruit_NeoPixel.h>

#define LED_PIN    6
#define LED_COUNT 24

int colour[4] = {255, 255, 255, 255};		// red, green, blue, white

Adafruit_NeoPixel ring(LED_COUNT, LED_PIN, NEO_GRB + NEO_KHZ800);
//////////

// Screen Libraries
#include <Wire.h>
#include <Adafruit_GFX.h>
#include <Adafruit_SSD1306.h>

// Screen Parameters
#define SCREEN_WIDTH 128
#define SCREEN_HEIGHT 64

Adafruit_SSD1306 display(SCREEN_WIDTH, SCREEN_HEIGHT, &Wire, -1);

char *colour_select;
//////////

// Servo Motor
#include <Servo.h>

Servo myservo;

int potpin = 0; 
int val = 90; 

// // // // // // // // 
// Buttons and Modes //
// // // // // // // // 

// Button Pins
#define BUTTON_MODE 4
#define BUTTON_POWER 5

// Modes
#define MODE_MAX 3
#define COLOUR_MODES 3

bool power_mode = 1;
bool power_mode_prev = 1;
int mode_reg = 0;
int latch_mode = -1;

// Button States
bool buttonMode_prev = 0;
bool buttonMode = 0;

bool buttonPower_prev = 0;
bool buttonPower = 0;

// // // // // // // // 

// LED Pins
#define LED_1 13
#define LED_2 12

// // // // // // // // 
// Bitmap faces
// // // // // // // // 

// Starting Cat
const unsigned char PROGMEM intro_cat_1[] = {
  // 45 x 52
	0x00, 0x00, 0x00, 0x00, 0x00, 0x00, 0x00, 0x00, 0x00, 0x00, 0x00, 0x00, 0x00, 0x00, 0x00, 0x00, 
	0x00, 0x00, 0x00, 0x00, 0x00, 0x00, 0x00, 0x00, 0x00, 0x00, 0x06, 0x00, 0x60, 0x00, 0x00, 0x00, 
	0x0e, 0x00, 0x90, 0x00, 0x00, 0x00, 0x11, 0x01, 0x10, 0x00, 0x00, 0x00, 0x21, 0xff, 0x10, 0x00, 
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	0x00, 0x00, 0x00, 0x00, 0x00, 0x00, 0x00, 0x00
};

// Starting Cat 2
const unsigned char PROGMEM intro_cat_2[] = {
  // 45 x 52
	0x00, 0x00, 0x00, 0x00, 0x00, 0x00, 0x00, 0x00, 0x00, 0x00, 0x00, 0x00, 0x00, 0x00, 0x00, 0x00, 
	0x00, 0x00, 0x00, 0x00, 0x00, 0x00, 0x00, 0x00, 0x00, 0x00, 0x06, 0x00, 0x60, 0x00, 0x00, 0x00, 
	0x0e, 0x00, 0x90, 0x00, 0x00, 0x00, 0x11, 0x01, 0x10, 0x00, 0x00, 0x00, 0x21, 0xff, 0x10, 0x00, 
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	0x00, 0x00, 0x00, 0x00, 0x00, 0x00, 0x00, 0x00
};

// Starting Cat
const unsigned char PROGMEM intro_cat_end[] = {
  // 72 x 44
	0x00, 0x00, 0x00, 0x00, 0x00, 0x00, 0x00, 0x00, 0x00, 0x00, 0x00, 0x00, 0x00, 0x00, 0x00, 0x00, 
	0x00, 0x00, 0x00, 0x00, 0x00, 0x00, 0x00, 0x00, 0x00, 0x00, 0x00, 0x00, 0x00, 0x00, 0x00, 0x00, 
	0x00, 0x00, 0x00, 0x00, 0x00, 0x00, 0x00, 0x00, 0x00, 0x00, 0x00, 0x00, 0x00, 0x00, 0x00, 0x00, 
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	0x00, 0x00, 0x00, 0x00, 0x00, 0x00, 0x00, 0x00, 0x00, 0x00, 0x00, 0x00
};

// Selection Screen
const unsigned char PROGMEM selection_screen[] = {
  // 101 x 24
	0x00, 0x00, 0x00, 0x00, 0x00, 0x00, 0x00, 0x00, 0x00, 0x00, 0x00, 0x00, 0x00, 0x00, 0x00, 0x00, 
	0x00, 0x00, 0x00, 0x00, 0x00, 0x00, 0x00, 0x00, 0x00, 0x00, 0x00, 0x00, 0x04, 0x00, 0x00, 0x00, 
	0x00, 0x00, 0x00, 0x60, 0x00, 0x00, 0x00, 0x00, 0x00, 0x3f, 0x00, 0x00, 0x00, 0x00, 0x00, 0x01, 
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	0x00, 0x00, 0x00, 0x00, 0x00, 0x00, 0x00, 0x00
};

// Cat Smile
const unsigned char PROGMEM cat_laying_screen[] = {
  // 73 x 64
	0x00, 0x00, 0x00, 0x00, 0x00, 0x00, 0x00, 0x00, 0x00, 0x00, 0x00, 0x00, 0x00, 0x00, 0x00, 0x00, 
	0x00, 0x00, 0x00, 0x00, 0x00, 0x00, 0x00, 0x00, 0x00, 0x00, 0x00, 0x00, 0x00, 0x00, 0x00, 0x00, 
	0x00, 0x00, 0x00, 0x00, 0x00, 0x00, 0x00, 0x00, 0x00, 0x00, 0x00, 0x00, 0x00, 0x00, 0x00, 0x00, 
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	0x00, 0x00, 0x00, 0x00, 0x00, 0x00, 0x00, 0x00, 0x00, 0x00, 0x00, 0x00, 0x00, 0x00, 0x00, 0x00
};


// // // // // // // // 
// Void Setup //
// // // // // // // // 
void setup() {
  Serial.begin(9600);

  // Ring
  ring.begin();           
  ring.show();
  ring.setBrightness(50); 
  //////////

  // Display Setup //
  if(!display.begin(SSD1306_SWITCHCAPVCC, 0x3C)) {
    Serial.println(F("SSD1306 allocation failed"));
    for(;;);
  }
  
  display.clearDisplay();
  display.setTextSize(1);
  display.setTextColor(WHITE);
  //////////
  
  // Servo
  myservo.attach(9);

  // Opening Animation
  opening_animation();
  
  // Buttons and LEDS
  pinMode(BUTTON_MODE, INPUT);
  pinMode(BUTTON_POWER, INPUT);
  pinMode(LED_1, OUTPUT);
  pinMode(LED_2, OUTPUT);
  //////////
}

void loop() {
  // T Flip FLip - POWER SWITCH
  buttonPower = digitalRead(BUTTON_POWER);
  if (buttonPower == 1 && buttonPower_prev == 0) {
    buttonPower_prev = 1;
    power_mode_prev = !power_mode_prev;
  }

  else if (buttonPower == 0 && buttonPower_prev == 1) {
    buttonPower_prev = 0;
  }
  
  ////////// ////////// //////////
  // POWER ON // 
  ////////// ////////// //////////
  if (power_mode_prev) {
    if (power_mode_prev != power_mode) { 
      opening_animation();
      
      Serial.println("enter");
    }
    power_mode = power_mode_prev;
    
    // Mode Switcher
    buttonMode = digitalRead(BUTTON_MODE);
    if (buttonMode == 1 && buttonMode_prev == 0) {
      buttonMode_prev = 1;
      mode_reg = mode_reg + 1;

      if (mode_reg == MODE_MAX) { mode_reg = 0; }
    }
    //////////

    else if (buttonMode == 0 && buttonMode_prev == 1) {
      buttonMode_prev = 0;
    }
    ////////// ////////// //////////

    ////////// ////////// //////////
    // Mode Chooser //
    ////////// ////////// //////////
    switch(mode_reg) {
      // Servo Control
      case 0: 
      // Pot Latch
      if (latch_mode != mode_reg) {
        if (movePot()) {
          servoMotorMode();
        }
      }

      else {
        servoMotorMode(); 
      }
      // Display
      servoMotorMode_display();
      break;
      //////////

      // Hue Control
      case 1:
      // Pot Latch
      if (latch_mode != mode_reg) {
        if (movePot()) {
          hueControlMode();
        }
      }

      else {
        hueControlMode(); 
      }
      // Display
      hueControlMode_display();
      break;
      //////////

      // Colour Picker
      case 2: 
      // Pot Latch
      if (latch_mode != mode_reg) {
        if (movePot()) {
          colorChooser();
          delay(100);
        }
      }

      else {
        colorChooser();
        delay(100); 
      }
      // Display
      colorChooser_display();
      break;
      //////////

      // Default Servo
      default: servoMotorMode();
          servoMotorMode_display();
      break;
    }
    ////////// ////////// //////////

    delay(15);
  }

  // Closing Down
  else if (power_mode_prev != power_mode && power_mode) {
    power_mode = power_mode_prev;

    // Display Cat Laying
    display.clearDisplay();
    display.drawBitmap(27, 0, cat_laying_screen, 73, 64, SSD1306_WHITE);
    display.display();
    closing_animation();

    // Clear LED and Brightness
    digitalWrite(LED_1, LOW);
    digitalWrite(LED_2, LOW);
    ring.setBrightness(0);
    ring.show();

    // Clear Screen (IDLE)
    display.clearDisplay();
    display.display();
  }
  
  else { delay(50); }
  
  Serial.println(power_mode);
}

//////////////////////
// Main Mode Module //
//////////////////////

// Servo Movement
void servoMotorMode() {
  val = analogRead(potpin);
  val = map(val, 0, 1023, 0, 180);
  Serial.println(val);
  myservo.write(val);
}

void servoMotorMode_display() {
  display.clearDisplay();
  selection_display(62, 44, "TURN");
  display.setCursor(110, 56);
  display.print(val);
  display.display();
}

// Color Hue
void hueControlMode() {
  val = analogRead(potpin);
  val = map(val, 0, 1023, 0, 360);
  delay(15);
  
  HSVtoRGB(val, 1.0, 1.0); 
  delay(15);
  
  ring_colour(colour);
}

void hueControlMode_display() {
  display.clearDisplay();
  selection_display(65, 44, "HUE");
  display.setCursor(110, 56);
  display.print(val);
  display.display();
}

// Color Chooser
void colorChooser() {
  val = analogRead(potpin);
  val = map(val, 0, 1023, 0, COLOUR_MODES);
  Serial.println(val);
  delay(15);
  
  
  switch (val) {
    case 0: colour_select = "white";
    break;
    case 1: colour_select = "red";
    break;
    case 2: colour_select = "green";
    break;
    case 3: colour_select = "blue";
    break;
    default: colour_select = "white";
    break;
  }
  delay(15);
  
  colourLib(colour_select);
  ring_colour(colour);
}

void colorChooser_display() {
  display.clearDisplay();
  selection_display(55, 44, "COLOUR");
  display.setCursor(110, 56);
  display.print(colour_select);
  display.display();
}

////////////////////

// potVal temp latch
bool movePot() {
  int initialVal = analogRead(potpin);
  //Serial.println(initialVal);
  delay(10);  // small debounce

  for (int i = 0; i < 100; i++) {  // wait max ~1.5s
    int currentVal = analogRead(potpin);
    if (abs(currentVal - initialVal) > 10) {  // threshold to avoid noise
      latch_mode = mode_reg;
      return true; // Pot moved
    }
    delay(15);
  }

  return false; // Pot did not move
}

// Ring colour Apply
void ring_colour(int colourVal[4]) {
  ring.setBrightness(255);
  
  ring.fill(ring.Color(colourVal[0], colourVal[1], colourVal[2]));  // Fill all pixels with red (RGB only)
  ring.show();
}


// Choose Colour of the Light
void colourLib(const char* colour_name) {
  if (strcmp(colour_name, "white") == 0 || strcmp(colour_name, "White") == 0) {
    colour[0] = 255;
    colour[1] = 255;
    colour[2] = 255;
    colour[3] = 255;
    // Serial.println("white");
    
  } else if (strcmp(colour_name, "red") == 0 || strcmp(colour_name, "Red") == 0) {
    colour[0] = 255;
    colour[1] = 0;
    colour[2] = 0;
    colour[3] = 0;
    // Serial.println("red");
    
  } else if (strcmp(colour_name, "green") == 0 || strcmp(colour_name, "Green") == 0) {
    colour[0] = 0;
    colour[1] = 255;
    colour[2] = 0;
    colour[3] = 0;
    // Serial.println("green");
    
  } else if (strcmp(colour_name, "blue") == 0 || strcmp(colour_name, "Blue") == 0) {
    colour[0] = 0;
    colour[1] = 0;
    colour[2] = 255;
    colour[3] = 0;
    // Serial.println("blue");
    
  } else {
    colour[0] = 255;
    colour[1] = 0;
    colour[2] = 0;
    colour[3] = 0;
    // Serial.println("none");
  }
}

// Convert HSV (Hue 0-360, Sat 0-1, Value 0-1) to RGB (0-255)
// CHATGpt-ed
void HSVtoRGB(float hue, float sat, float val) {
  float c = val * sat;
  float x = c * (1 - abs(fmod(hue / 60.0, 2) - 1));
  float m = val - c;

  float r1, g1, b1;
  if (hue < 60)      { r1 = c; g1 = x; b1 = 0; }
  else if (hue < 120){ r1 = x; g1 = c; b1 = 0; }
  else if (hue < 180){ r1 = 0; g1 = c; b1 = x; }
  else if (hue < 240){ r1 = 0; g1 = x; b1 = c; }
  else if (hue < 300){ r1 = x; g1 = 0; b1 = c; }
  else             { r1 = c; g1 = 0; b1 = x; }

  colour[0] = (r1 + m) * 255;
  colour[1] = (g1 + m) * 255;
  colour[2] = (b1 + m) * 255;
}

// // // // // // // // // //
// Animation and Displays //
// // // // // // // // // // 

// Selection Display <- x axis, y axis, display print
void selection_display(int x, int y, char *display_text) {
  // Display Selection
  display.drawBitmap(23, 15, selection_screen, 101, 24, SSD1306_WHITE);
  display.setCursor(x, y);
  display.print(display_text);
}

// Opening Animation of the device
void opening_animation() {  
  int NEW_LED_POINT = LED_COUNT / 1.3;
  for(int i = 0; i < (LED_COUNT + NEW_LED_POINT); i++) {
    display.clearDisplay();

    if (i < LED_COUNT) {
      if (i < NEW_LED_POINT) { 
        display.drawBitmap(40, 2, intro_cat_1, 45, 52, SSD1306_WHITE);
        display.setCursor(35, 56);
        display.print("Loading LED"); 
      }

    	ring.setPixelColor(i, random(255), random(255), random(255), 0);
    }
    if (i >= NEW_LED_POINT) {
      display.drawBitmap(40, 5, intro_cat_2, 45, 52, SSD1306_WHITE);
      display.setCursor(26, 56);
      display.print("Loading Colour");

      ring.setPixelColor(i - NEW_LED_POINT, colour[0], colour[1], colour[2], colour[3]);
    }
    display.display();
    ring.show();
    delay(50);
  }

  display.clearDisplay();
  display.drawBitmap(28, 25, intro_cat_end, 72, 44, SSD1306_WHITE);
  display.setTextSize(2);
  display.setCursor(34, 10);
  display.print("START");
  display.display();
  display.setTextSize(1);
}


// Closing Animation of the device
void closing_animation() {
  Serial.println("closing");
  for(int i = ring.numPixels()-1; i >= 0; i--) {
      ring.setPixelColor(i, 0, 0, 0, 0);
      ring.show();
      delay(50);
    if (i % 2) {
      digitalWrite(LED_1, HIGH);
      digitalWrite(LED_2, LOW); 
    }
    else {
      digitalWrite(LED_1, LOW);
      digitalWrite(LED_2, HIGH); 
     }
      
  }
  digitalWrite(LED_1, LOW);
  digitalWrite(LED_2, LOW); 
}
